## conf/layer.conf
```bitbake
# SPDX-License-Identifier: MIT

# We have a conf and classes directory, append to BBPATH
BBPATH .= ":${LAYERDIR}"

# We have recipes-* directories, add to BBFILES
BBFILES += "${LAYERDIR}/recipes-*/*/*.bb \
            ${LAYERDIR}/recipes-*/*/*.bbappend"

BBFILE_COLLECTIONS += "cyclonedx"
BBFILE_PATTERN_cyclonedx += "^${LAYERDIR}/"
BBFILE_PRIORITY_cyclonedx = "6"

LAYERDEPENDS_cyclonedx = "core"
LAYERSERIES_COMPAT_cyclonedx = "mickledore"
```
